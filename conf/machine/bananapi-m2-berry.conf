## conf/machine/bananapi-m2-berry.conf
```bitbake
#@TYPE: Machine
#@NAME: bananapi-m2-berry
#@DESCRIPTION: Machine configuration for the bananapi-m2-berry, base on allwinner V40 CPU

require conf/machine/include/sun8i.inc

KERNEL_DEVICETREE = "sun8i-v40-bananapi-m2-berry.dtb"
UBOOT_MACHINE = "bananapi_m2_berry_defconfig"
```

## conf/machine/bananapi-m2-plus.conf
```bitbake
#@TYPE: Machine
#@NAME: orange-pi-one
#@DESCRIPTION: Machine configuration for the orange-pi-one, base on allwinner H3 CPU

require conf/machine/include/sun8i.inc

KERNEL_DEVICETREE = "sun8i-h3-bananapi-m2-plus.dtb"
UBOOT_MACHINE = "bananapi_m2_plus_h3_defconfig"
```

## conf/machine/bananapi-m2-ultra.conf
```bitbake
#@TYPE: Machine
#@NAME: bananapi-m2-ultra
#@DESCRIPTION: Machine configuration for the bananapi-m2-ultra, base on allwinner R40 CPU

require conf/machine/include/sun8i.inc

PREFERRED_VERSION_u-boot = "v2018.09%"

KERNEL_DEVICETREE = "sun8i-r40-bananapi-m2-ultra.dtb"
UBOOT_MACHINE = "Bananapi_M2_Ultra_defconfig"

KERNEL_IMAGETYPE ?= "uImage"
KERNEL_BOOTCMD ?= "bootm"
```

## conf/machine/bananapi-m2-zero.conf
```bitbake
#@TYPE: Machine
#@NAME: orange-pi-one
#@DESCRIPTION: Machine configuration for the orange-pi-one, base on allwinner H3 CPU

require conf/machine/include/sun8i.inc

KERNEL_DEVICETREE = "sun8i-h2-plus-bananapi-m2-zero.dtb"
UBOOT_MACHINE = "bananapi_m2_zero_defconfig"
```

## conf/machine/bananapi-m3.conf
```bitbake
#@TYPE: Machine
#@NAME: bananapi-m3
#@DESCRIPTION: Machine configuration for the bananapi-m3, based on Allwinner A83T CPU


require conf/machine/include/sun8i.inc

KERNEL_DEVICETREE = "sun8i-a83t-bananapi-m3.dtb"
UBOOT_MACHINE = "Sinovoip_BPI_M3_defconfig"
```

## conf/machine/bananapi-m64.conf
```bitbake
#@TYPE: Machine
#@NAME: bananapi-m64
#@DESCRIPTION: Machine configuration for the bananapi-m64, based on Allwinner A64 CPU


require conf/machine/include/sun50i.inc

PREFERRED_VERSION_u-boot = "v2018.09%"
PREFERRED_VERSION_linux-mainline = "5.2%"

KERNEL_DEVICETREE = "allwinner/sun50i-a64-bananapi-m64.dtb"
UBOOT_MACHINE = "bananapi_m64_defconfig"

# bpi, add for balena build
KERNEL_IMAGETYPE ?= "Image"
KERNEL_BOOTCMD ?= "booti"
```
